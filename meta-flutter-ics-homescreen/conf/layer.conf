## meta-flutter-ics-homescreen/conf/layer.conf
```bitbake
# We have a conf and classes directory, add to BBPATH
BBPATH .= ":${LAYERDIR}"

# We have recipes-* directories, add to BBFILES
BBFILES += "${LAYERDIR}/recipes-*/*/*.bb \
            ${LAYERDIR}/recipes-*/*/*.bbappend"

BBFILE_COLLECTIONS += "meta-flutter-ics-homescreen"
BBFILE_PATTERN_meta-flutter-ics-homescreen = "^${LAYERDIR}/"
BBFILE_PRIORITY_meta-flutter-ics-homescreen = "10"

LAYERDEPENDS_meta-flutter-ics-homescreen = "core flutter-layer"
LAYERSERIES_COMPAT_meta-flutter-ics-homescreen = "kirkstone scarthgap"
```
